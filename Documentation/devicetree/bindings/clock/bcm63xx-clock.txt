## Documentation/devicetree/bindings/clock/bcm63xx-clock.txt
```
* Broadcom BCM63XX Clock bindings

This binding uses the common clock binding[1].

[1] Documentation/devicetree/bindings/clock/clock-bindings.txt

Required properties:
- compatible: one of
  a) "brcm,bcm63xx-clock"
  Standard BCM63XX clock.
  b) "brcm,bcm63xx-sar-clock"
  SAR/ATM clock, which requires a reset of the SAR/ATM block.
  c) "brcm,bcm63xx-enetsw-clock"
  Generic ethernet switch clock, which requires a reset of the block.
  d) "brcm,bcm6368-enetsw-clock"
  BCM6368 ethernet switch clock, which requires additional clocks to be
  enabled during reset.

Optional properties:
- brcm,gate-bit: gate bit in the clock control register.

- clock-frequency: frequency of this clock.

Example:

	hsspi: clock@9 {
		compatible = "brcm,bcm63xx-clock";
		#clock-cells = <0>;
		clock-output-names = "hsspi";
		brcm,gate-bit = <9>;
		clock-frequency = <133333333>;
	};
```

## Documentation/devicetree/bindings/gpio/bcm63xx-gpio.txt
```
* Broadcom BCM63XX GPIO controller

Required properties:
- compatible: "brcm,bcm63xx-gpio"
  Compatible with all BCM63XX SoCs.

- reg: address and length of the register block.

- gpio-controller: This is a GPIO controller.

- #gpio-cells: Must be <2>. The first cell is the GPIO pin, and
  the second one the standard linux flags.

- ngpio: number of GPIOs present in this SoC.

Example:

	gpio: gpio@80 {
		compatible = "brcm,bcm63xx-gpio";
		reg = <0x80 0x80>;
		gpio-controller;
		#gpio-cells = <2>;
		ngpio = <40>;
	};
```

## Documentation/devicetree/bindings/mips/bcm63xx/epic.txt
```
* Broadcom BCM63XX External Interrupt Controller

Properties:
- compatible: "brcm,bcm63xx-epic"
  Compatible with all bcm63xx SoCs.

- interrupt-controller: This is an interrupt controller.

- #interrupt-cells: <2>
  This controller supports level and edge triggered interrupts. The
  first cell is the interrupt number, the second is a 1:1 mapping to
  the linux interrupt flags.

Example:

	epic: interrupt-controller@18 {
		compatible = "brcm,bcm63xx-epic";
		interrupt-controller;
		#interrupt-cells = <2>;
	}
```

## Documentation/devicetree/bindings/mips/bcm63xx/ipic.txt
```
* BCM63XX Internal Interrupt Controller

Properties:
- compatible: "brcm,bcm63xx-ipic"
  Compatible with all bcm63xx SoCs.

- interrupt-controller: This is an interrupt controller.

- #interrupt-cells: <1>
  This controller supports only level interrupts.

Example:

	ipic: interrupt-controller@20 {
		compatible = "brcm,bcm63xx-ipic";
		interrupt-controller;
		#interrupt-cells = <1>;
	}
```

## Documentation/devicetree/bindings/pinctrl/brcm,bcm6318-pinctrl.txt
```
* Broadcom BCM6318 pin controller

Required properties:
- compatible: "brcm,bcm6318-pinctrl"
- regs: register specifiers of dat, dirout, mode, mux, and pad registers.
- reg-names: must be "dat", "dirout", "mode", "mux", "pad".
- gpio-controller: identifies this node as a gpio controller.
- #gpio-cells: must be 2.

Example:

pinctrl: pin-controller@10000080 {
	compatible = "brcm,bcm6318-pinctrl";
	reg = <0x10000080 0x08>,
	      <0x10000088 0x08>,
	      <0x10000098 0x04>,
	      <0x1000009c 0x0c>,
	      <0x100000d4 0x18>;
	reg-names = "dirout", "dat", "mode", "mux", "pad";

	gpio-controller;
	#gpio-cells = <2>;
};


Available pins/groups and functions:

name		pins	functions
-----------------------------------------------------------
gpio0		0	led, ephy0_spd_led
gpio1		1	led, ephy1_spd_led
gpio2		2	led, ephy2_spd_led
gpio3		3	led, ephy3_spd_led
gpio4		4	led, ephy0_act_led
gpio5		5	led, ephy1_act_led
gpio6		6	led, ephy2_act_led, serial_led_data
gpio7		7	led, ephy3_act_led, serial_led_clk
gpio8		8	led, inet_act_led
gpio9		9	led, inet_fail_led
gpio10		10	led, dsl_led
gpio11		11	led, post_fail_led
gpio12		12	led, wlan_wps_led
gpio13		13	led, usb_pwron, usb_device_led
gpio14		14	led
gpio15		15	led
gpio16		16	led
gpio17		17	led
gpio18		18	led
gpio19		19	led
gpio20		20	led
gpio21		21	led
gpio22		22	led
gpio23		23	led
gpio24		24	-
gpio25		25	-
gpio26		26	-
gpio27		27	-
gpio28		28	-
gpio29		29	-
gpio30		30	-
gpio31		31	-
gpio32		32	-
gpio33		33	-
gpio34		34	-
gpio35		35	-
gpio36		36	-
gpio37		37	-
gpio38		38	-
gpio39		39	-
gpio40		40	usb_active
gpio41		41	-
gpio42		42	-
gpio43		43	-
gpio44		44	-
gpio45		45	-
gpio46		46	-
gpio47		47	-
gpio48		48	-
gpio49		49	-
```

## Documentation/devicetree/bindings/pinctrl/brcm,bcm6328-pinctrl.txt
```
* Broadcom BCM6328 pin controller

Required properties:
- compatible: must be "brcm,bcm6328-pinctrl"
- reg: register specifies of dat, dirout, mode, mux registers.
- reg-names: must be "dat", "dirout", "mode", "mux".
- gpio-controller: identifies this node as a gpio-controller.
- #gpio-cells: must be 2.

Example:

pinctrl: pin-controller@10000080 {
	compatible = "brcm,bcm6328-pinctrl";
	reg = <0x10000080 0x8>,
	      <0x10000088 0x8>,
	      <0x10000098 0x4>,
	      <0x1000009c 0xc>;
	reg-names = "dirout", "dat", "mode", "mux";

	gpio-controller;
	#gpio-cells = <2>;
};

Available pins/groups and functions:

name		pins	functions
-----------------------------------------------------------
gpio0		0	led
gpio1		1	led
gpio2		2	led
gpio3		3	led
gpio4		4	led
gpio5		5	led
gpio6		6	led, serial_led_data
gpio7		7	led, serial_led_clk
gpio8		8	led
gpio9		9	led
gpio10		10	led
gpio11		11	led
gpio12		12	led
gpio13		13	led
gpio14		14	led
gpio15		15	led
gpio16		16	led, pcie_clkreq
gpio17		17	led
gpio18		18	led
gpio19		19	led
gpio20		20	led
gpio21		21	led
gpio22		22	led
gpio23		23	led
gpio24		24	-
gpio25		25	ephy0_act_led
gpio26		26	ephy1_act_led
gpio27		27	ephy2_act_led
gpio28		28	ephy3_act_led
gpio29		29	-
gpio30		30	-
gpio31		31	-
hsspi_cs1	-	hsspi_cs1
usb_port1	-	usb_host_port, usb_device_port
```

## Documentation/devicetree/bindings/pinctrl/brcm,bcm6348-pinctrl.txt
```
* Broadcom BCM6348 pin controller

Required properties:
- compatible: "brcm,bcm6348-pinctrl"
- reg: register specifiers of data, dirout, mode registers.
- reg-names: must be "dat", "dirout", "mode".
- gpio-controller: identifies this node as a gpio-controller.
- #gpio-cells: must be 2.

Example:

pinctrl: pin-controller@fffe0080 {
	compatible = "brcm,bcm6348-pinctrl";
	reg = <0xfffe0080 0x8>,
	      <0xfffe0088 0x8>,
	      <0xfffe0098 0x4>;
	reg-names = "dirout", "dat", "mode";

	gpio-controller;
	#gpio-cells = <2>;
};

Available pins/groups and functions:

name		pins	functions
-----------------------------------------------------------
group0		32-36	ext_mii, utopia, diag
group1		22-31	ext_ephy, mii_snoop, mii_pccard,
			spi_master_uart, utopia, diag
group2		16-21	pci, diag
group3		8-15	ext_mii, utopia
group4		0-7	ext_ephy, mii_snoop, legacy_led, diag
```

## Documentation/devicetree/bindings/pinctrl/brcm,bcm6358-pinctrl.txt
```
* Broadcom BCM6358 pin controller

Required properties:
- compatible: must be "brcm,bcm6358-pinctrl".
- reg: register specifiers of data, dirout registers.
- reg-names: must be "dat", "dirout".
- brcm,gpiomode: phandle to the shared gpiomode register.
- gpio-controller: identifies this node as a gpio-controller.
- #gpio-cells: must be <2>.

Example:

pinctrl: pin-controller@fffe0080 {
	compatible = "brcm,bcm6358-pinctrl";
	reg = <0xfffe0080 0x8>,
	      <0xfffe0088 0x8>,
	      <0xfffe0098 0x4>;
	reg-names = "dirout", "dat";
	brcm,gpiomode = <&gpiomode>;

	gpio-controller;
	#gpio-cells = <2>;
};

gpiomode: syscon@fffe0098 {
	compatible = "brcm,bcm6358-gpiomode", "syscon";
	reg = <0xfffe0098 0x4>;
	native-endian;
};

Available pins/groups and functions:

name		pins		functions
-----------------------------------------------------------
ebi_cs_grp	30-31		ebi_cs
uart1_grp	28-31		uart1
spi_cs_grp	32-33		spi_cs
async_modem_grp	12-15		async_modem
legacy_led_grp	9-15		legacy_led
serial_led_grp	6-7		serial_led
led_grp		0-3		led
utopia_grp	12-15, 22-31	utopia
pwm_syn_clk_grp	8		pwm_syn_clk
sys_irq_grp	5		sys_irq
```

## Documentation/devicetree/bindings/pinctrl/brcm,bcm6362-pinctrl.txt
```
* Broadcom BCM6362 pin controller

Required properties:
- compatible: "brcm,bcm6362-pinctrl"
- regs: register specifies of data, dirout, led, mode, ctrl, basemode registers.
- reg-names: must be "dat", "dirout", "led", "mode", "ctrl", "basemode".
- gpio-controller
- #gpio-cells: must be 2.

Example:

pinctrl: pin-controller@10000080 {
	compatible = "brcm,bcm6362-pinctrl";
	reg = <0x10000080 0x8>,
	      <0x10000088 0x8>,
	      <0x10000090 0x4>,
	      <0x10000098 0x4>,
	      <0x1000009c 0x4>,
	      <0x100000b8 0x4>;
	reg-names = "dirout", "dat", "led",
		    "mode", "ctrl", "basemode";

	gpio-controller;
	#gpio-cells = <2>;
};

Available pins/groups and functions:

name		pins		functions
-----------------------------------------------------------
gpio0		0		led, usb_device_led
gpio1		1		led, sys_irq
gpio2		2		led, serial_led_clk
gpio3		3		led, serial_led_data
gpio4		4		led, robosw_led_data
gpio5		5		led, robosw_led_clk
gpio6		6		led, robosw_led0
gpio7		7		led, robosw_led1
gpio8		8		led, inet_led
gpio9		9		led, spi_cs2
gpio10		10		led, spi_cs3
gpio11		11		led, ntr_pulse
gpio12		12		led, uart1_scts
gpio13		13		led, uart1_srts
gpio14		14		led, uart1_sdin
gpio15		15		led, uart1_sdout
gpio16		16		led, adsl_spi_miso
gpio17		17		led, adsl_spi_mosi
gpio18		18		led, adsl_spi_clk
gpio19		19		led, adsl_spi_cs
gpio20		20		led, ephy0_led
gpio21		21		led, ephy1_led
gpio22		22		led, ephy2_led
gpio23		23		led, ephy3_led
gpio24		24		ext_irq0
gpio25		25		ext_irq1
gpio26		26		ext_irq2
gpio27		27		ext_irq3
gpio28		28		-
gpio29		29		-
gpio30		30		-
gpio31		31		-
gpio32		32		wifi
gpio33		33		wifi
gpio34		34		wifi
gpio35		35		wifi
gpio36		36		wifi
gpio37		37		wifi
gpio38		38		wifi
gpio39		39		wifi
gpio40		40		wifi
gpio41		41		wifi
gpio42		42		wifi
gpio43		43		wifi
gpio44		44		wifi
gpio45		45		wifi
gpio46		46		wifi
gpio47		47		wifi
nand_grp	8, 12-23, 27	nand
```

## Documentation/devicetree/bindings/pinctrl/brcm,bcm6368-pinctrl.txt
```
* Broadcom BCM6368 pin controller

Required properties:
- compatible: "brcm,bcm6368-pinctrl"
- regs: register specifies of data, dirout, mode registers.
- reg-names: must be "dat", "dirout", "mode".
- brcm,gpiobasemode: phandle to the gpio basemode register.
- gpio-controller: identifies this node as a gpio-controller.
- #gpio-cells: must be 2.

Example:

pinctrl: pin-controller@10000080 {
	compatible = "brcm,bcm6368-pinctrl";
	reg = <0x10000080 0x08>,
	      <0x10000088 0x08>,
	      <0x10000098 0x04>;
	reg-names = "dirout", "dat", "mode";
	brcm,gpiobasemode = <&gpiobasemode>;

	gpio-controller;
	#gpio-cells = <2>;
};

gpiobasemode: syscon@100000b8 {
	compatible = "brcm,bcm6368-gpiobasemode", "syscon";
	reg = <0x100000b8 4>;
	native-endian;
};

Available pins/groups and functions:

name		pins	functions
-----------------------------------------------------------
gpio0		0	analog_afe0
gpio1		1	analog_afe1
gpio2		2	sys_irq
gpio3		3	serial_led_data
gpio4		4	serial_led_clk
gpio5		5	inet_led
gpio6		6	ephy0_led
gpio7		7	ephy1_led
gpio8		8	ephy2_led
gpio9		9	ephy3_led
gpio10		10	robosw_led_data
gpio11		11	robosw_led_clk
gpio12		12	robosw_led0
gpio13		13	robosw_led1
gpio14		14	usb_device_led
gpio15		15	-
gpio16		16	pci_req1
gpio17		17	pci_gnt1
gpio18		18	pci_intb
gpio19		19	pci_req0
gpio20		20	pci_gnt0
gpio21		21	-
gpio22		22	pcmcia_cd1
gpio23		23	pcmcia_cd2
gpio24		24	pcmcia_vs1
gpio25		25	pcmcia_vs2
gpio26		26	ebi_cs2
gpio27		27	ebi_cs3
gpio28		28	spi_cs2
gpio29		29	spi_cs3
gpio30		30	spi_cs4
gpio31		31	spi_cs5
uart1_grp	30-33	uart1
```

## Documentation/devicetree/bindings/tty/serial/bcm63xx-uart.txt
```
* Broadcom BCM63XX UART

Required properties:
- compatible: "brcm,bcm63xx-uart"
  Compatible with all BCM63XX SoCs.

- reg: address and length of the register block.

- interrupts: the uart's interrupt number.

Example:

	uart0: serial@100 {
		compatible = "brcm,bcm63xx";
		reg = <0x100 0x18>;
		interrupts = <2>;
	};
```

## arch/mips/bcm63xx/dts/Kconfig
```kconfig
menu "Built-in Device Tree support"

config BOARD_96328AVNG
	bool "96328avng reference board"
	select BCM63XX_CPU_6328

config BOARD_96338GW
	bool "96338GW reference board"
	select BCM63XX_CPU_6338

config BOARD_96338W
	bool "96338W reference board"
	select BCM63XX_CPU_6338

config BOARD_96345GW2
	bool "96345GW2 reference board"
	select BCM63XX_CPU_6345

config BOARD_96348R
	bool "96348R reference board"
	select BCM63XX_CPU_6348

config BOARD_96348GW
	bool "96348GW reference board"
	select BCM63XX_CPU_6348

config BOARD_96348GW_10
	bool "96348GW-10 reference board"
	select BCM63XX_CPU_6348

config BOARD_96348GW_11
	bool "96348GW-11 reference board"
	select BCM63XX_CPU_6348

config BOARD_96348GW_A
	bool "96348GW-A reference board"
	select BCM63XX_CPU_6348

config BOARD_96358VW
	bool "96358VW2 reference board"
	select BCM63XX_CPU_6358

config BOARD_96358VW2
	bool "96358VW2 reference board"
	select BCM63XX_CPU_6358

config BOARD_AGPF_S0
	bool "AGPF-S0 (Pirelli Alice Gate VoIP 2 Plus Wi-Fi Business)"
	select BCM63XX_CPU_6358

config BOARD_DV201AMR
	bool "DV201AMR (Davolink DV-201AMR)"
	select BCM63XX_CPU_6348

config BOARD_DWV_S0
	bool "DWV-S0 (Pirelli A226G)"
	select BCM63XX_CPU_6358

config BOARD_FAST2404
	bool "F@ST2404 (Sagem F@ST2404)"
	select BCM63XX_CPU_6348

config BOARD_RTA2015W_16
	bool "RTA2015W_16 (Dynalink RTA2015W)"
	select BCM63XX_CPU_6348

endmenu
```

## arch/mips/configs/bcm63xx_defconfig
```kconfig
CONFIG_BCM63XX=y
CONFIG_BCM63XX_CPU_6328=y
CONFIG_BCM63XX_CPU_6338=y
CONFIG_BCM63XX_CPU_6345=y
CONFIG_BCM63XX_CPU_6348=y
CONFIG_BCM63XX_CPU_6358=y
CONFIG_BCM63XX_CPU_6368=y
# CONFIG_SECCOMP is not set
CONFIG_EXPERIMENTAL=y
# CONFIG_LOCALVERSION_AUTO is not set
# CONFIG_SWAP is not set
CONFIG_NO_HZ=y
CONFIG_SYSFS_DEPRECATED=y
CONFIG_SYSFS_DEPRECATED_V2=y
CONFIG_EXPERT=y
# CONFIG_VM_EVENT_COUNTERS is not set
# CONFIG_SLUB_DEBUG is not set
# CONFIG_BLK_DEV_BSG is not set
# CONFIG_IOSCHED_DEADLINE is not set
# CONFIG_IOSCHED_CFQ is not set
CONFIG_PCI=y
CONFIG_PCCARD=y
CONFIG_PCMCIA_BCM63XX=y
CONFIG_NET=y
CONFIG_PACKET=y
CONFIG_UNIX=y
CONFIG_INET=y
# CONFIG_INET_XFRM_MODE_TRANSPORT is not set
# CONFIG_INET_XFRM_MODE_TUNNEL is not set
# CONFIG_INET_XFRM_MODE_BEET is not set
# CONFIG_INET_LRO is not set
# CONFIG_INET_DIAG is not set
CONFIG_CFG80211=y
CONFIG_NL80211_TESTMODE=y
# CONFIG_CFG80211_WEXT is not set
CONFIG_MAC80211=y
CONFIG_MAC80211_LEDS=y
CONFIG_UEVENT_HELPER_PATH="/sbin/hotplug"
# CONFIG_STANDALONE is not set
# CONFIG_PREVENT_FIRMWARE_BUILD is not set
CONFIG_MTD=y
CONFIG_MTD_BCM63XX_PARTS=y
CONFIG_MTD_CHAR=y
CONFIG_MTD_BLOCK=y
CONFIG_MTD_CFI=y
CONFIG_MTD_CFI_INTELEXT=y
CONFIG_MTD_CFI_AMDSTD=y
CONFIG_MTD_PHYSMAP=y
CONFIG_MTD_M25P80=y
# CONFIG_BLK_DEV is not set
CONFIG_NETDEVICES=y
CONFIG_BCM63XX_ENET=y
CONFIG_BCM63XX_PHY=y
CONFIG_B43=y
# CONFIG_B43_PHY_LP is not set
# CONFIG_INPUT is not set
# CONFIG_SERIO is not set
# CONFIG_VT is not set
# CONFIG_DEVKMEM is not set
CONFIG_SERIAL_BCM63XX=y
CONFIG_SERIAL_BCM63XX_CONSOLE=y
# CONFIG_HW_RANDOM is not set
CONFIG_SPI=y
CONFIG_SPI_BCM63XX=y
# CONFIG_HWMON is not set
# CONFIG_VGA_ARB is not set
CONFIG_USB=y
CONFIG_USB_EHCI_HCD=y
# CONFIG_USB_EHCI_TT_NEWSCHED is not set
CONFIG_USB_OHCI_HCD=y
CONFIG_USB_GADGET=y
CONFIG_USB_GADGET_DEBUG_FILES=y
CONFIG_USB_GADGET_DEBUG_FS=y
CONFIG_USB_ETH=y
CONFIG_NEW_LEDS=y
CONFIG_LEDS_CLASS=y
CONFIG_LEDS_GPIO=y
CONFIG_LEDS_TRIGGER_TIMER=y
CONFIG_LEDS_TRIGGER_GPIO=y
CONFIG_LEDS_TRIGGER_DEFAULT_ON=y
# CONFIG_FILE_LOCKING is not set
# CONFIG_DNOTIFY is not set
CONFIG_PROC_KCORE=y
CONFIG_TMPFS=y
CONFIG_JFFS2_FS=y
CONFIG_SQUASHFS=y
CONFIG_SQUASHFS_XZ=y
# CONFIG_NETWORK_FILESYSTEMS is not set
CONFIG_MAGIC_SYSRQ=y
CONFIG_DEBUG_FS=y
CONFIG_CMDLINE_BOOL=y
CONFIG_CMDLINE="console=ttyS0,115200"
# CONFIG_CRYPTO_HW is not set
# CONFIG_XZ_DEC_X86 is not set
# CONFIG_XZ_DEC_POWERPC is not set
# CONFIG_XZ_DEC_IA64 is not set
# CONFIG_XZ_DEC_ARM is not set
# CONFIG_XZ_DEC_ARMTHUMB is not set
# CONFIG_XZ_DEC_SPARC is not set
```
