## drivers/mtd/parsers/Kconfig
```kconfig
config MTD_PARSER_IMAGETAG
	tristate "Parser for BCM963XX Image Tag format partitions"
	depends on BCM63XX || BMIPS || COMPILE_TEST
	select CRC32
	help
	  Image Tag is the firmware header used by broadcom on their xDSL line
	  of devices. It is used to describe the offsets and lengths of kernel
	  and rootfs partitions.
	  This driver adds support for parsing a partition with an Image Tag
	  header and creates up to two partitions, kernel and rootfs.

config MTD_PARSER_TRX
	tristate "Parser for TRX format partitions"
	depends on MTD && (BCM47XX || ARCH_BCM_5301X || COMPILE_TEST)
	help
	  TRX is a firmware format used by Broadcom on their devices. It
	  may contain up to 3/4 partitions (depending on the version).
	  This driver will parse TRX header and report at least two partitions:
	  kernel and rootfs.

config MTD_SHARPSL_PARTS
	tristate "Sharp SL Series NAND flash partition parser"
	depends on MTD_NAND_SHARPSL || MTD_NAND_TMIO || COMPILE_TEST
	help
	  This provides the read-only FTL logic necessary to read the partition
	  table from the NAND flash of Sharp SL Series (Zaurus) and the MTD
	  partition parser using this code.
```

## drivers/pinctrl/bcm63xx/Kconfig
```kconfig
config PINCTRL_BCM63XX
	bool
	select GPIO_GENERIC

config PINCTRL_BCM6328
	bool "BCM6328 pincontrol driver" if COMPILE_TEST
	select PINMUX
	select PINCONF
	select PINCTRL_BCM63XX
	select GENERIC_PINCONF

config PINCTRL_BCM6348
	bool "BCM6348 pincontrol driver" if COMPILE_TEST
	select PINMUX
	select PINCONF
	select PINCTRL_BCM63XX
	select GENERIC_PINCONF

config PINCTRL_BCM6358
	bool "BCM6358 pincontrol driver" if COMPILE_TEST
	select PINMUX
	select PINCONF
	select PINCTRL_BCM63XX
	select GENERIC_PINCONF
	select MFD_SYSCON
```
