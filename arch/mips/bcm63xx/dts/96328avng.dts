/dts-v1/;

/*
 * Device Tree Source for Broadcom BCM96328avng reference board
 *
 * Copyright (C) 2012 Jonas Gorski <jonas.gorski@gmail.com>
 *
 * This file is licensed under the terms of the GNU General Public License
 * version 2.  This program is licensed "as is" without any warranty of any
 * kind, whether express or implied.
 */

/include/ "bcm6328.dtsi"

/ {
	model = "96328avng";
	compatible = "96328avng";

	ubus@10000000 {

		serial@100 {
			status = "ok";
		};
	};
};
