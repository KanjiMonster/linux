/dts-v1/;

/*
 * Device Tree Source for Broadcom BCM96345GW2 reference board
 *
 * Copyright (C) 2012 Jonas Gorski <jonas.gorski@gmail.com>
 *
 * This file is licensed under the terms of the GNU General Public License
 * version 2.  This program is licensed "as is" without any warranty of any
 * kind, whether express or implied.
 */

/include/ "bcm6345.dtsi"

/ {
	model = "96345GW2";
	compatible = "96345GW2";

	ubus@fffe0000 {

		serial@300 {
			status = "ok";
		};
	};
};
