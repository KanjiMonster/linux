/dts-v1/;

/*
 * Device Tree Source for Broadcom 96348GWR reference board
 *
 * Copyright (C) 2012 Jonas Gorski <jonas.gorski@gmail.com>
 *
 * This file is licensed under the terms of the GNU General Public License
 * version 2.  This program is licensed "as is" without any warranty of any
 * kind, whether express or implied.
 */

/include/ "bcm6348.dtsi"

/ {
	model = "96348R";
	compatible = "96348R";

	ubus@fffe0000 {

		serial@300 {
			status = "ok";
		};
	};
};
