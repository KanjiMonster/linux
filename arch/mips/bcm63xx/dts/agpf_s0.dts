/dts-v1/;

/*
 * Device Tree Source for Pirelli Alice Gate VoIP 2 Plus Wi-Fi Business board
 *
 * Copyright (C) 2012 Jonas Gorski <jonas.gorski@gmail.com>
 *
 * This file is licensed under the terms of the GNU General Public License
 * version 2.  This program is licensed "as is" without any warranty of any
 * kind, whether express or implied.
 */

/include/ "bcm6358.dtsi"

/ {
	model = "AGPF-S0";
	compatible = "AGPF-S0";

	ubus@fffe0000 {

	};
};
