/dts-v1/;

/*
 * Fallback Device Tree Source for Broadcom BCM6348 based boards
 *
 * Copyright (C) 2012 Jonas Gorski <jonas.gorski@gmail.com>
 *
 * This file is licensed under the terms of the GNU General Public License
 * version 2.  This program is licensed "as is" without any warranty of any
 * kind, whether express or implied.
 */

/include/ "bcm6348.dtsi"

/ {
	model = "Generic BCM6348 board";
	compatible = "bcm96348-generic";

	ubus@fffe0000 {
	};
};
