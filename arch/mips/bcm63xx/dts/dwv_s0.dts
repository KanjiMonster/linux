/dts-v1/;

/*
 * Device Tree Source for Pirelli A226G
 *
 * Copyright (C) 2012 Jonas Gorski <jonas.gorski@gmail.com>
 *
 * This file is licensed under the terms of the GNU General Public License
 * version 2.  This program is licensed "as is" without any warranty of any
 * kind, whether express or implied.
 */

/include/ "bcm6358.dtsi"

/ {
	model = "DWV-S0";
	compatible = "DWV-S0";

	ubus@fffe0000 {

	};
};
