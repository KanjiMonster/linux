/dts-v1/;

/*
 * Device Tree Source for Dynalink RTA2015W board
 *
 * Copyright (C) 2012 Jonas Gorski <jonas.gorski@gmail.com>
 *
 * This file is licensed under the terms of the GNU General Public License
 * version 2.  This program is licensed "as is" without any warranty of any
 * kind, whether express or implied.
 */

/include/ "bcm6348.dtsi"

/ {
	model = "RTA1025W_16";
	compatible = "RTA1025W_16";

	ubus@fffe0000 {

	};
};
